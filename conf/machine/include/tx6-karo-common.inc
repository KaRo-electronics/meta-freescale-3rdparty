## conf/machine/include/tx6-karo-common.inc
```bitbake
# Provides the Ka-Ro TX6 common settings

require conf/machine/include/imx-base.inc
require conf/machine/include/tune-cortexa9.inc

SERIAL_CONSOLE = "115200 ttymxc0"

UBOOT_SUFFIX = "bin"
UBOOT_MAKE_TARGET = "u-boot.bin"
UBOOT_BINARY="u-boot.bin"

PREFERRED_PROVIDER_u-boot ?= "u-boot-karo"
PREFERRED_PROVIDER_virtual/bootloader ?= "u-boot-karo"

PREFERRED_PROVIDER_virtual/kernel ?= "linux-karo"

MACHINE_FIRMWARE_append_mx6 = " linux-firmware-ath6k"
MACHINE_FEATURES += " pci wifi bluetooth"
IMAGE_FSTYPES_remove = "sdcard"
IMAGE_FSTYPES = "tar.bz2"

# Add NXP binary blob driver for the Vivante GPU to the kernel image.
# Otherwise settings in the Kernel defconfig are actively delete or ignored and
# the required external LKM ([RFS]/lib/modules/<kernel-version>/extra) is not
# available at all ( exception being if specific images are being "bitbaked"
# like: fsl-image-multimedia-full )

# Add Vivante GPU driver support
# Handle Vivante kernel driver setting:
#   0 - machine does not have Vivante GPU driver support
#   1 - machine has Vivante GPU driver support
MACHINE_HAS_VIVANTE_KERNEL_DRIVER_SUPPORT ?= "1"

# Use Vivante kernel driver module:
#   0 - enable the builtin kernel driver module
#   1 - enable the external kernel module
MACHINE_USES_VIVANTE_KERNEL_DRIVER_MODULE ?= "0"

TXBASE ?= "mb7"
```

## conf/machine/include/tx6ul-karo-common.inc
```bitbake
# Provides the Ka-Ro TX6UL common settings

require conf/machine/include/imx-base.inc
require conf/machine/include/tune-cortexa7.inc

SERIAL_CONSOLE = "115200 ttymxc0"

UBOOT_SUFFIX = "bin"
UBOOT_MAKE_TARGET = "u-boot.bin"
UBOOT_BINARY="u-boot.bin"
UBOOT_ENTRYPOINT_mx6ul = "0x80008000"

PREFERRED_PROVIDER_u-boot ?= "u-boot-karo"
PREFERRED_PROVIDER_virtual/kernel ?= "linux-karo"

IMAGE_FSTYPES = "tar.bz2"

TXBASE ?= "evalkit"
```

## conf/machine/tx6q-1130.conf
```bitbake
#@TYPE: Machine
#@NAME: Ka-Ro electronics i.MX6Q TX6Q Computer-On-Module
#@SOC: i.MX6Q
#@DESCRIPTION: Machine configuration for Ka-Ro electronics TX6Q Computer-On-Module
#@MAINTAINER: Oliver Wendt <ow@karo-electronics.com>

require include/tx6-karo-common.inc

SOC_FAMILY = "mx6:mx6q:tx6"

KERNEL_DEVICETREE ?= "imx6q-tx6q-1110.dtb"

UBOOT_MACHINE = "tx6q-11x0_config"

TXTYPE = "imx6q-tx6"
TXNVM = "nand"
TXBASE_append = "-lvds"
```

## conf/machine/tx6q-8037.conf
```bitbake
#@TYPE: Machine
#@NAME: Ka-Ro electronics i.MX6QP TX6QP Computer-On-Module
#@SOC: i.MX6QP
#@DESCRIPTION: Machine configuration for Ka-Ro electronics TX6DL Computer-On-Module
#@MAINTAINER: Oliver Wendt <ow@karo-electronics.com>

require include/tx6-karo-common.inc

SOC_FAMILY = "mx6:mx6q:tx6"

KERNEL_DEVICETREE ?= "imx6qp-tx6qp-8037.dtb"

UBOOT_MACHINE = "tx6qp-8037_config"

TXTYPE = "imx6qp-tx6"
TXNVM = "emmc"
```

## conf/machine/tx6u-8030.conf
```bitbake
#@TYPE: Machine
#@NAME: Ka-Ro electronics i.MX6DL TX6DL Computer-On-Module
#@SOC: i.MX6DL
#@DESCRIPTION: Machine configuration for Ka-Ro electronics TX6DL Computer-On-Module
#@MAINTAINER: Oliver Wendt <ow@karo-electronics.com>

require include/tx6-karo-common.inc

SOC_FAMILY = "mx6:mx6dl:tx6"

KERNEL_DEVICETREE ?= "imx6dl-tx6u-801x.dtb"

UBOOT_MACHINE = "tx6u-80x0_config"

TXTYPE = "imx6dl-tx6"
TXNVM = "nand"
```

## conf/machine/tx6u-8133.conf
```bitbake
#@TYPE: Machine
#@NAME: Ka-Ro electronics i.MX6DL TX6DL Computer-On-Module
#@SOC: i.MX6DL
#@DESCRIPTION: Machine configuration for Ka-Ro electronics TX6DL Computer-On-Module
#@MAINTAINER: Oliver Wendt <ow@karo-electronics.com>

require include/tx6-karo-common.inc

SOC_FAMILY = "mx6:mx6dl:tx6"

KERNEL_DEVICETREE ?= "imx6dl-tx6u-8133.dtb"

UBOOT_MACHINE = "tx6u-8133_config"

TXTYPE = "imx6dl-tx6"
TXNVM = "emmc"
TXBASE_append = "-lvds"
```

## conf/machine/txul-5010.conf
```bitbake
#@TYPE: Machine
#@NAME: Ka-Ro electronics TX6UL NAND
#@SOC: i.MX6UL
#@DESCRIPTION: Machine configuration for Ka-Ro electronics TX6UL (i.MX6UL) Computer-On-Module with NAND
#@MAINTAINER: Oliver Wendt <ow@karo-electronics.com>

require include/tx6ul-karo-common.inc

SOC_FAMILY = "mx6:mx6ul:txul"

UBOOT_MACHINE = "tx6ul-0010_config"

KERNEL_DEVICETREE = "imx6ul-tx6ul-0010.dtb"

TXTYPE = "imx6ul-tx6"
TXNVM = "nand"
```

## conf/machine/txul-5011.conf
```bitbake
#@TYPE: Machine
#@NAME: Ka-Ro electronics TX6UL eMMC
#@SOC: i.MX6UL
#@DESCRIPTION: Machine configuration for Ka-Ro electronics TX6UL (i.MX6UL) Computer-On-Module with eMMC
#@MAINTAINER: Oliver Wendt <ow@karo-electronics.com>

require include/tx6ul-karo-common.inc

SOC_FAMILY = "mx6:mx6ul:txul"

UBOOT_MACHINE = "tx6ul-0011_config"

KERNEL_DEVICETREE = "imx6ul-tx6ul-0011.dtb"

TXTYPE = "imx6ul-tx6"
TXNVM = "emmc"
```

## conf/machine/txul-8013.conf
```bitbake
#@TYPE: Machine
#@NAME: Ka-Ro electronics TX6UL NAND
#@SOC: i.MX6ULL
#@DESCRIPTION: Machine configuration for Ka-Ro electronics TX6ULL (i.MX6ULL) Computer-On-Module with eMMC
#@MAINTAINER: Oliver Wendt <ow@karo-electronics.com>

require include/tx6ul-karo-common.inc

SOC_FAMILY = "mx6ul:txul"

UBOOT_MACHINE = "tx6ul-8013_config"

KERNEL_DEVICETREE = "imx6ull-txul-8013.dtb"

TXTYPE = "imx6ul-tx6"
TXNVM = "emmc"

PREFERRED_VERSION_linux-karo = "4.13"
```
